## firmware/payloads/ecall_bench_k3_next.its
```
/dts-v1/;

/ {
	description = "K3 ECALL benchmark S-mode next stage";
	#address-cells = <2>;
	fit,fdt-list = "of-list";

	images {
		uboot {
			description = "Minimal S-mode ECALL benchmark";
			type = "standalone";
			os = "u-boot";
			arch = "riscv";
			compression = "none";
			load = <0x1 0x02000000>;
			entry = <0x1 0x02000000>;
			data = /incbin/("./payloads/test.bin");
			hash-1 {
				algo = "crc32";
			};
		};

		fdt_1 { description = "k3_fpga.dtb"; type = "flat_dt"; compression = "none"; data = /incbin/("./fdt_1.dtb"); hash-1 { algo = "crc32"; }; };
		fdt_2 { description = "k3_evb.dtb"; type = "flat_dt"; compression = "none"; data = /incbin/("./fdt_2.dtb"); hash-1 { algo = "crc32"; }; };
		fdt_3 { description = "k3_deb1.dtb"; type = "flat_dt"; compression = "none"; data = /incbin/("./fdt_3.dtb"); hash-1 { algo = "crc32"; }; };
		fdt_4 { description = "k3_com260.dtb"; type = "flat_dt"; compression = "none"; data = /incbin/("./fdt_4.dtb"); hash-1 { algo = "crc32"; }; };
		fdt_5 { description = "k3_dc_board.dtb"; type = "flat_dt"; compression = "none"; data = /incbin/("./fdt_5.dtb"); hash-1 { algo = "crc32"; }; };
		fdt_6 { description = "k3_com260_kit_v02.dtb"; type = "flat_dt"; compression = "none"; data = /incbin/("./fdt_6.dtb"); hash-1 { algo = "crc32"; }; };
		fdt_7 { description = "k3_gemini_c0.dtb"; type = "flat_dt"; compression = "none"; data = /incbin/("./fdt_7.dtb"); hash-1 { algo = "crc32"; }; };
		fdt_8 { description = "k3_gemini_c1.dtb"; type = "flat_dt"; compression = "none"; data = /incbin/("./fdt_8.dtb"); hash-1 { algo = "crc32"; }; };
		fdt_9 { description = "k3_evb2-1.dtb"; type = "flat_dt"; compression = "none"; data = /incbin/("./fdt_9.dtb"); hash-1 { algo = "crc32"; }; };
		fdt_10 { description = "k3_evb2-2.dtb"; type = "flat_dt"; compression = "none"; data = /incbin/("./fdt_10.dtb"); hash-1 { algo = "crc32"; }; };
		fdt_11 { description = "k3-pico-itx.dtb"; type = "flat_dt"; compression = "none"; data = /incbin/("./fdt_11.dtb"); hash-1 { algo = "crc32"; }; };
		fdt_12 { description = "k3_BS01DCMA.dtb"; type = "flat_dt"; compression = "none"; data = /incbin/("./fdt_12.dtb"); hash-1 { algo = "crc32"; }; };
		fdt_13 { description = "k3_com260_ifx.dtb"; type = "flat_dt"; compression = "none"; data = /incbin/("./fdt_13.dtb"); hash-1 { algo = "crc32"; }; };
	};

	configurations {
		default = "conf_3";
		conf_1 { description = "k3_fpga"; loadables = "uboot"; fdt = "fdt_1"; };
		conf_2 { description = "k3_evb"; loadables = "uboot"; fdt = "fdt_2"; };
		conf_3 { description = "k3_deb1"; loadables = "uboot"; fdt = "fdt_3"; };
		conf_4 { description = "k3_com260"; loadables = "uboot"; fdt = "fdt_4"; };
		conf_5 { description = "k3_dc_board"; loadables = "uboot"; fdt = "fdt_5"; };
		conf_6 { description = "k3_com260_kit_v02"; loadables = "uboot"; fdt = "fdt_6"; };
		conf_7 { description = "k3_gemini_c0"; loadables = "uboot"; fdt = "fdt_7"; };
		conf_8 { description = "k3_gemini_c1"; loadables = "uboot"; fdt = "fdt_8"; };
		conf_9 { description = "k3_evb2-1"; loadables = "uboot"; fdt = "fdt_9"; };
		conf_10 { description = "k3_evb2-2"; loadables = "uboot"; fdt = "fdt_10"; };
		conf_11 { description = "k3-pico-itx"; loadables = "uboot"; fdt = "fdt_11"; };
		conf_12 { description = "k3_BS01DCMA"; loadables = "uboot"; fdt = "fdt_12"; };
		conf_13 { description = "k3_com260_ifx"; loadables = "uboot"; fdt = "fdt_13"; };
	};
};
```

## firmware/payloads/ecall_bench_k3_sd.its
```
/dts-v1/;

/ {
	description = "OpenSBI ECALL benchmark with built-in S-mode payload";
	#address-cells = <2>;
	fit,fdt-list = "of-list";

	images {
		opensbi {
			description = "OpenSBI fw_payload ECALL benchmark";
			type = "firmware";
			os = "opensbi";
			arch = "riscv";
			compression = "none";
			load = <0x1 0x0>;
			entry = <0x1 0x0>;
			data = /incbin/("./fw_payload.bin");
			hash-1 {
				algo = "crc32";
			};
		};
	};

	configurations {
		default = "config_1";

		config_1 {
			description = "OpenSBI ECALL benchmark FIT config";
			firmware = "opensbi";
		};
	};
};
```

## lib/utils/cci/Kconfig
```kconfig
# SPDX-License-Identifier: BSD-2-Clause

menuconfig CCI
	bool "CCI BUS driver support"
	default n

if CCI

config CCI_550
	bool "CCI 550 driver"
	default n

endif
```

## lib/utils/mpxy/Kconfig
```kconfig
# SPDX-License-Identifier: BSD-2-Clause

menu "MPXY Device Support"

config FDT_MPXY
	bool "FDT based MPXY drivers"
	depends on FDT
	default n

config FDT_MPXY_RPMI_MBOX
	bool "MPXY drivers as RPMI mailbox client"
	depends on FDT_MAILBOX && FDT_MPXY
	default n

if FDT_MPXY_RPMI_MBOX

config FDT_MPXY_RPMI_CLOCK
	bool "MPXY driver for RPMI clock service group"
	default n

config FDT_MPXY_RPMI_VOLTAGE
	bool "MPXY driver for RPMI voltage service group"
	default n

config FDT_MPXY_RPMI_DOMAIN
	bool "MPXY driver for RPMI power domain service group"
	default n

config FDT_MPXY_RPMI_RTC
	bool "MPXY driver for RPMI rtc service group"
	default n

config FDT_MPXY_RPMI_PWRKEY
	bool "MPXY driver for RPMI pwrkey service group"
	default n

config FDT_MPXY_RPMI_SYSMSI
	bool "MPXY driver for RPMI system MSI service group"
	default n

endif

config FDT_MPXY_OPTEED
	bool "FDT MPXY OP-TEE secure payload dispatcher (SPD) driver"
	default n

endmenu
```

## platform/generic/Kconfig
```kconfig
# SPDX-License-Identifier: BSD-2-Clause

config PLATFORM_GENERIC
	bool
	select FDT
	select FDT_DOMAIN
	select FDT_PMU
	default y

if PLATFORM_GENERIC

config PLATFORM_GENERIC_NAME
	string "Platform default name"
	default "Generic"

config PLATFORM_GENERIC_MAJOR_VER
	int "Platform major version"
	range 0 65535
	default 0

config PLATFORM_GENERIC_MINOR_VER
	int "Platform minor version"
	range 0 65535
	default 1

config PLATFORM_ALLWINNER_D1
	bool "Allwinner D1 support"
	depends on FDT_IRQCHIP_PLIC
	select THEAD_C9XX_PMU
	default n

config PLATFORM_ANDES_AE350
	bool "Andes AE350 support"
	select SYS_ATCSMU
	select ANDES_PMU
	select ANDES_PMA
	default n

config PLATFORM_RENESAS_RZFIVE
	bool "Renesas RZ/Five support"
	select ANDES_PMA
	select ANDES_SBI
	select ANDES_PMU
	default n

config PLATFORM_SIFIVE_FU540
	bool "SiFive FU540 support"
	default n

config PLATFORM_SIFIVE_FU740
	bool "SiFive FU740 support"
	depends on FDT_RESET && FDT_I2C
	default n

config PLATFORM_SOPHGO_SG2042
	bool "Sophgo sg2042 support"
	select THEAD_C9XX_ERRATA
	select THEAD_C9XX_PMU
	default n

config PLATFORM_STARFIVE_JH7110
	bool "StarFive JH7110 support"
	default n

config PLATFORM_THEAD
	bool "THEAD C9xx support"
	select THEAD_C9XX_ERRATA
	select THEAD_C9XX_PMU
	default n

config PLATFORM_SPACEMIT_K3
       bool "Spacemit K3 support"
       default n


if PLATFORM_SPACEMIT_K3
	config PLATFORM_SPACEMIT_K3_FPGA
		bool "Spacemit K3 board fpag"
		default n

	config FIT_SIGNATURE
		bool "Enable signature build for FIT Images"
		default n
		help
			This option enables build signature for FIT Images,
			using a hash signed and verified using RSA.

			WARNING: When relying on signed FIT images with a required signature
			check the legacy image format is disabled by default, so that
			unsigned images cannot be loaded.
endif

source "$(OPENSBI_SRC_DIR)/platform/generic/andes/Kconfig"
source "$(OPENSBI_SRC_DIR)/platform/generic/thead/Kconfig"

endif
```

## platform/generic/configs/ecall_bench_defconfig
```kconfig
CONFIG_SBI_ECALL_BENCH=y
CONFIG_FDT_IPI=y
CONFIG_FDT_IPI_MSWI=y
CONFIG_FDT_IRQCHIP=y
CONFIG_FDT_IRQCHIP_PLIC=y
CONFIG_FDT_SERIAL=y
CONFIG_FDT_SERIAL_UART8250=y
CONFIG_FDT_TIMER=y
CONFIG_FDT_TIMER_MTIMER=y
```
